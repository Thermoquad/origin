## west.yml
```yaml
manifest:
  remotes:
    - name: zephyrproject-rtos
      url-base: git@github.com:zephyrproject-rtos
    - name: thermoquad
      url-base: git@github.com:Thermoquad
  projects:
    - name: zephyr
      remote: zephyrproject-rtos
      revision: v4.4.0
      import: true
    - name: zephyr-cyw43-bt
      remote: thermoquad
      revision: master
      path: modules/lib/zephyr-cyw43-bt
    - name: zephyr-servo-rpi-pio
      remote: thermoquad
      revision: master
      path: modules/drivers/zephyr-servo-rpi-pio
  self:
    path: origin
```
